## configs/x86_64.defconfig
```kconfig
# ============================================================
#  x86_64 目标基础配置（由 build.sh 与 packages.list 合并使用）
#  这里只放"目标平台"相关的设置，软件包请写 configs/packages.list
# ============================================================

# ---- 目标平台：x86 / 64 位 ----
CONFIG_TARGET_x86=y
CONFIG_TARGET_x86_64=y
CONFIG_TARGET_x86_64_Generic=y
CONFIG_TARGET_BOARD="x86"
CONFIG_TARGET_SUBTARGET="64"
CONFIG_TARGET_PROFILE="Generic"

# ---- 分区大小（关键：决定 overlay 可用空间）----
# 默认值在此，build.sh 会用 device.conf 的 KERNEL_SIZE_MB/ROOTFS_SIZE_MB 覆盖
CONFIG_TARGET_KERNEL_PARTSIZE=128
CONFIG_TARGET_ROOTFS_PARTSIZE=2048

# ---- 镜像格式：squashfs（可恢复出厂）+ EFI 启动 ----
CONFIG_TARGET_ROOTFS_SQUASHFS=y
CONFIG_TARGET_ROOTFS_EXT4FS=n
CONFIG_TARGET_IMAGES_GZIP=y
CONFIG_GRUB_IMAGES=y
CONFIG_GRUB_EFI_IMAGES=y

# ---- 内核必备驱动：x86 常见网卡（Intel/Realtek 全家桶）----
CONFIG_PACKAGE_kmod-e1000e=y
CONFIG_PACKAGE_kmod-igb=y
CONFIG_PACKAGE_kmod-igc=y
CONFIG_PACKAGE_kmod-ixgbe=y
CONFIG_PACKAGE_kmod-r8168=y
CONFIG_PACKAGE_kmod-r8125=y
CONFIG_PACKAGE_kmod-r8126=y
CONFIG_PACKAGE_kmod-usb-net=y
CONFIG_PACKAGE_kmod-usb-net-rtl8152-vendor=y
CONFIG_PACKAGE_kmod-usb-net-asix-ax88179=y

# ---- 千兆转发：流卸载（配合 21-bandwidth 首启脚本）----
CONFIG_PACKAGE_kmod-nft-offload=y

# ---- 文件系统支持 ----
CONFIG_PACKAGE_kmod-fs-ext4=y
CONFIG_PACKAGE_kmod-fs-f2fs=y
CONFIG_PACKAGE_kmod-fs-vfat=y
CONFIG_PACKAGE_kmod-fs-ntfs3=y
CONFIG_PACKAGE_kmod-usb-storage=y

# ---- 中文语言包依赖 ----
CONFIG_LUCI_LANG_zh_Hans=y

# ---- 杂项 ----
CONFIG_PACKAGE_libustream-openssl=y
CONFIG_STRIP_KERNEL_EXPORTS=y
```
